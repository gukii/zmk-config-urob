/* source key position labels */
#include "zmk-helpers/key-labels/34.h"


/* activate bluetooth */
#define CONFIG_WIRELESS 1

/* source the main keymap */
/* #include "base.keymap" */
#include "base.apple.keymap"

/* use 5-column layout for Zen */
/*ZMK_APPLY_MATRIX_TRANSFORM(five_column_transform)*/
